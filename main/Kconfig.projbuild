## main/Kconfig.projbuild
```kconfig
menu "Irrigation System Configuration"

    config WIFI_SSID
        string "WiFi SSID"
        default "myssid"
        help
            SSID (network name) 

    config WIFI_PASSWORD
        string "WiFi Password"
        default "mypassword"
        help
            WiFi password (WPA or WPA2) 

    config WIFI_MAXIMUM_RETRY
        int "Maximum retry"
        default 100
        help
            Set the Maximum retry to avoid station reconnecting to the AP unlimited when the AP is really inexistent.

    config WATERING_OUTPUT_GPIO_NO
        int "Watering Device Output GPIO No"
        default 13
        help
            GPIO number for valve signals

    config MONITORING_OUTPUT_GPIO_NO
        int "Monitoring Output GPIO No"
        default 25
        help
            GPIO number for monitoring signals

    config WATERING_INPUT_GPIO_NO
        int "Watering Button GPIO No"
        default 34
        help
            GPIO number for valve signals

    config IS_ENABLE_VOLTAGE_CHECK
        bool "Is Enable Voltage Check Option"
        default y
        help
            If you do not use the voltage check process, disable it

    config VAOLTAGE_CHECK_OUTPUT_GPIO_NO
        int "Voltage Check Output GPIO No"
        default 26
        help
            GPIO number for voltage check signals

    config VAOLTAGE_CHECK_INPUT_ADC_CHANNEL_NO
        int "Voltage Check Input ADC1 Channel No"
        default 7
        help
            GPIO number for voltage check adc input signals

    config VOLTAGE_CHECK_TOP_REGISTER
        int "Voltage Check Top Register (Ω)"
        default 10000
        help
            voltage check top register 

    config VOLTAGE_CHECK_BOTTOM_REGISTER
        int "Voltage Check Bottomp Register (Ω)"
        default 2200
        help
            voltage check bottom register 

    config IS_ENABLE_WATER_LEVEL_CHECK
        bool "Is Enable Water Level Check Option"
        default y
        help
            If you do not use the water level check process, disable it

    config WATER_LEVEL_CHECK_OUTPUT_GPIO_NO
        int "Voltage Check Output GPIO No"
        default 27
        help
            GPIO number for voltage check signals

    config WATER_LEVEL_CHECK_INPUT_ADC_CHANNEL_NO
        int "Voltage Check Input ADC1 Channel No"
        default 3
        help
            GPIO number for voltage check adc input signals

    config LOCAL_TIME_ZONE
        string "Local Time Zone"
        default "JST-9"
        help
            Time zone of the region to be used

    config NTP_SERVER_ADDRESS
        string "NTP Server Address"
        default "ntp.nict.jp"
        help
            NTP server address to use for time alignment

    config DEBUG
        bool "Debug Mode"
        default n
        help
            Set a non-zero number to build as debug mode.

endmenu
```

## sdkconfig.defaults
```kconfig
# Irrigation System sdkconfig Default

# Cpu Freq
CONFIG_ESP32_DEFAULT_CPU_FREQ_80=y
CONFIG_ESP32_DEFAULT_CPU_FREQ_160=n
CONFIG_ESP32_DEFAULT_CPU_FREQ_240=n

# Enable C++ exceptions and set emergency pool size for exception objects
CONFIG_COMPILER_CXX_EXCEPTIONS=y
CONFIG_COMPILER_CXX_EXCEPTIONS_EMG_POOL_SIZE=1024

# Compiler Optimize
CONFIG_COMPILER_OPTIMIZATION_DEFAULT=n
CONFIG_COMPILER_OPTIMIZATION_SIZE=n
CONFIG_COMPILER_OPTIMIZATION_PERF=y
CONFIG_COMPILER_OPTIMIZATION_NONE=n

# HTTPD Request Header
CONFIG_HTTPD_MAX_REQ_HDR_LEN=1024

# Serial flasher config
CONFIG_ESPTOOLPY_FLASHSIZE_2MB=n
CONFIG_ESPTOOLPY_FLASHSIZE_4MB=y
CONFIG_ESPTOOLPY_FLASHSIZE="4MB"

# Partition Table
CONFIG_PARTITION_TABLE_SINGLE_APP=n
CONFIG_PARTITION_TABLE_CUSTOM=y

# Enable RTC 32kHz XTAL  (Option: Must be ESP32-WROOM-32E or higher)
CONFIG_ESP32_RTC_CLK_SRC_INT_RC=n
CONFIG_ESP32_RTC_CLK_SRC_EXT_CRYS=y
CONFIG_ESP32_RTC_EXT_CRYST_ADDIT_CURRENT_NONE=y
CONFIG_ESP32_RTC_XTAL_CAL_RETRY=1000

# Fat FS
CONFIG_FATFS_LFN_NONE=n
CONFIG_FATFS_LFN_HEAP=y
CONFIG_FATFS_MAX_LFN=255
CONFIG_FATFS_API_ENCODING_ANSI_OEM=n
CONFIG_FATFS_API_ENCODING_UTF_8=y
```
